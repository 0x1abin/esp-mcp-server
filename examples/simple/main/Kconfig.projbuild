## examples/simple/main/Kconfig.projbuild
```kconfig
menu "MCP Component Example Configuration"

    config EXAMPLE_LED_GPIO
        int "LED GPIO number"
        range 0 48
        default 2 if IDF_TARGET_ESP32
        default 8 if IDF_TARGET_ESP32C2 || IDF_TARGET_ESP32C3
        default 2 if IDF_TARGET_ESP32C6
        default 2 if IDF_TARGET_ESP32S2
        default 48 if IDF_TARGET_ESP32S3
        default 2
        help
            GPIO number for the LED that can be controlled via MCP.

    config EXAMPLE_BUTTON_GPIO
        int "Button GPIO number"
        range 0 48
        default 0 if IDF_TARGET_ESP32
        default 9 if IDF_TARGET_ESP32C2 || IDF_TARGET_ESP32C3
        default 9 if IDF_TARGET_ESP32C6
        default 0 if IDF_TARGET_ESP32S2
        default 0 if IDF_TARGET_ESP32S3
        default 0
        help
            GPIO number for the button that can be read via MCP.

endmenu
```

## examples/simple/sdkconfig.defaults
```kconfig
# HTTP Server Configuration
CONFIG_HTTPD_MAX_REQ_HDR_LEN=1024
CONFIG_HTTPD_MAX_URI_LEN=512
```
